## Documentation/devicetree/bindings/display/panel/csot,vtdr6130.yaml
```yaml
# SPDX-License-Identifier: GPL-2.0-only OR BSD-2-Clause
%YAML 1.2
---
$id: http://devicetree.org/schemas/display/panel/csot,vtdr6130.yaml#
$schema: http://devicetree.org/meta-schemas/core.yaml#

title: CSOT VTDR6130 AMOLED DSI Panel

maintainers:
  - Jens Reidel <adrian@travitia.xyz>

allOf:
  - $ref: panel-common.yaml#

properties:
  compatible:
    const: csot,vtdr6130

  reg:
    maxItems: 1
    description: DSI virtual channel

  reset-gpios: true
  vdd-supply: true
  vddio-supply: true
  dvdd-supply: true
  port: true

required:
  - compatible
  - reg
  - reset-gpios
  - vdd-supply
  - vddio-supply
  - dvdd-supply
  - port

additionalProperties: false

examples:
  - |
    #include <dt-bindings/gpio/gpio.h>

    dsi {
        #address-cells = <1>;
        #size-cells = <0>;

        panel@0 {
            compatible = "csot,vtdr6130";
            reg = <0>;

            reset-gpios = <&tlmm 44 GPIO_ACTIVE_LOW>;

            vdd-supply = <&vreg_l13c_3p0>;
            vddio-supply = <&vreg_l12c_1p8>;
            dvdd-supply = <&vreg_oled_dvdd>;

            port {
                panel_in: endpoint {
                    remote-endpoint = <&mdss_dsi0_out>;
                };
            };
        };
    };
...
```

## Documentation/devicetree/bindings/input/awinic,aw8624.yaml
```yaml
# SPDX-License-Identifier: (GPL-2.0-only OR BSD-2-Clause)
%YAML 1.2
---
$id: http://devicetree.org/schemas/input/awinic,aw8624.yaml#
$schema: http://devicetree.org/meta-schemas/core.yaml#

title: Awinic AW8624 LRA Haptic Controller

maintainers:
  - Oleksii Onchul <oleksiionchul@gmail.com>

properties:
  compatible:
    const: awinic,aw8624

  reg:
    maxItems: 1

  vdd-supply:
    description: Power supply for the controller.

  reset-gpios:
    description: Active-low hardware reset.
    maxItems: 1

  interrupts:
    maxItems: 1

  awinic,resonant-freq-hz:
    description:
      Nominal resonant frequency of the connected linear resonant actuator.
      The driver uses this value to generate the RAM waveform.
    minimum: 100
    maximum: 300

required:
  - compatible
  - reg
  - reset-gpios
  - interrupts
  - awinic,resonant-freq-hz

additionalProperties: false

examples:
  - |
    #include <dt-bindings/gpio/gpio.h>
    #include <dt-bindings/interrupt-controller/irq.h>

    i2c {
        #address-cells = <1>;
        #size-cells = <0>;

        vibrator@5a {
            compatible = "awinic,aw8624";
            reg = <0x5a>;
            interrupts-extended = <&tlmm 18 IRQ_TYPE_EDGE_FALLING>;
            reset-gpios = <&tlmm 35 GPIO_ACTIVE_LOW>;
            awinic,resonant-freq-hz = <205>;
        };
    };
```

## Documentation/devicetree/bindings/media/i2c/samsung,s5k3t2.yaml
```yaml
# SPDX-License-Identifier: (GPL-2.0-only OR BSD-2-Clause)
%YAML 1.2
---
$id: http://devicetree.org/schemas/media/i2c/samsung,s5k3t2.yaml#
$schema: http://devicetree.org/meta-schemas/core.yaml#

title: Samsung S5K3T2 image sensor

description:
  The Samsung S5K3T2 is a 20-megapixel CMOS image sensor. It outputs RAW10
  image data over a four-lane MIPI CSI-2 D-PHY interface.

maintainers:
  - Oleksii Onchul <oleksiionchul@gmail.com>

allOf:
  - $ref: /schemas/media/video-interface-devices.yaml#

properties:
  compatible:
    const: samsung,s5k3t2

  reg:
    maxItems: 1

  clocks:
    description: Sensor input clock
    maxItems: 1

  reset-gpios:
    description: Active-low reset GPIO
    maxItems: 1

  vdda-supply:
    description: Analogue power supply, 2.8 volts

  vddd-supply:
    description: Digital core power supply, 1.05 volts

  vddio-supply:
    description: Digital I/O power supply, 1.8 volts

  port:
    $ref: /schemas/graph.yaml#/$defs/port-base
    additionalProperties: false

    properties:
      endpoint:
        $ref: /schemas/media/video-interfaces.yaml#
        unevaluatedProperties: false

        properties:
          data-lanes:
            items:
              - const: 1
              - const: 2
              - const: 3
              - const: 4

        required:
          - link-frequencies

required:
  - compatible
  - reg
  - clocks
  - reset-gpios
  - vdda-supply
  - vddd-supply
  - vddio-supply
  - port

unevaluatedProperties: false

examples:
  - |
    #include <dt-bindings/gpio/gpio.h>

    i2c {
        #address-cells = <1>;
        #size-cells = <0>;

        camera@10 {
            compatible = "samsung,s5k3t2";
            reg = <0x10>;
            clocks = <&camera_clk>;
            reset-gpios = <&gpio 20 GPIO_ACTIVE_LOW>;
            vdda-supply = <&camera_vana>;
            vddd-supply = <&camera_vdig>;
            vddio-supply = <&camera_vio>;

            port {
                endpoint {
                    data-lanes = <1 2 3 4>;
                    link-frequencies = /bits/ 64 <240000000 716800000>;
                    remote-endpoint = <&csi_receiver_ep>;
                };
            };
        };
    };
...
```

## Documentation/devicetree/bindings/sound/nxp,tfa9872.yaml
```yaml
# SPDX-License-Identifier: (GPL-2.0-only OR BSD-2-Clause)
%YAML 1.2
---
$id: http://devicetree.org/schemas/sound/nxp,tfa9872.yaml#
$schema: http://devicetree.org/meta-schemas/core.yaml#

title: NXP TFA9872/TFA9873/TFA9874 Audio Amplifiers

maintainers:
  - Jens Reidel <adrian@travitia.xyz>

allOf:
  - $ref: dai-common.yaml#

properties:
  compatible:
    oneOf:
      - enum:
          - nxp,tfa9872
          - nxp,tfa9874
      - items:
          - const: nxp,tfa9873
          - const: nxp,tfa9872

  reg:
    maxItems: 1

  reset-gpios:
    maxItems: 1

  '#sound-dai-cells':
    const: 1

  sound-name-prefix: true

  sound-channel:
    $ref: /schemas/types.yaml#/definitions/uint32
    minimum: 0
    maximum: 15
    description: TDM speaker slot used by the amplifier.

  max-coil-current:
    $ref: /schemas/types.yaml#/definitions/uint32
    description: Maximum coil current selector for the DC-DC converter.

  first-boost-voltage:
    $ref: /schemas/types.yaml#/definitions/uint32
    description: First boost voltage selector for the DC-DC converter.

  second-boost-voltage:
    $ref: /schemas/types.yaml#/definitions/uint32
    description: Second boost voltage selector for the DC-DC converter.

  first-boost-trip-lvl:
    $ref: /schemas/types.yaml#/definitions/uint32
    description: First boost trip level selector for the DC-DC converter.

  second-boost-trip-lvl:
    $ref: /schemas/types.yaml#/definitions/uint32
    description: Second boost trip level selector for the DC-DC converter.

required:
  - compatible
  - reg
  - '#sound-dai-cells'

additionalProperties: false

examples:
  - |
    #include <dt-bindings/gpio/gpio.h>

    i2c {
        #address-cells = <1>;
        #size-cells = <0>;

        audio-codec@34 {
            compatible = "nxp,tfa9873", "nxp,tfa9872";
            reg = <0x34>;
            reset-gpios = <&tlmm 2 GPIO_ACTIVE_HIGH>;
            sound-name-prefix = "Speaker Left";
            #sound-dai-cells = <1>;
            sound-channel = <0>;
        };
    };

...
```
